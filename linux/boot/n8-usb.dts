/* first boot on the nokia n8 (same rapuyama soc as the e6, untested there):
 * usb shell + ram log only. no display, no i2c chips (the e6 keypad/touch
 * addresses may be something else on this board), no swd (its addresses come
 * from the e6 firmware), no rootfs on the card */
/include/ "e6-usb.dts"

/ {
	compatible = "nokia,n8", "nokia,rapuyama";
	model = "Nokia N8-00 (RapuYama)";

	chosen {
		bootargs = "earlycon=ramcon,0x1f000000 keep_bootcon console=ttyNULL panic=10 nohlt clk_ignore_unused pd_ignore_unused cma=0 e6.usbsh";
	};
};

&i2c0 {
	status = "disabled";
};

/* the l220 address is from the e6 rom, not checked on this phone */
/delete-node/ &l2c;