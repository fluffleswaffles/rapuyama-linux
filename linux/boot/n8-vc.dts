/* n8-usb.dts + the videocore driver with the e6 panel setup (640x480, standard
 * dcs only). second test: the log gets the vc boot + the panel id, the picture
 * is probably wrong (the n8 panel is 360x640) */
/include/ "e6-vc.dts"

/ {
	compatible = "nokia,n8", "nokia,rapuyama";
	model = "Nokia N8-00 (RapuYama)";

	chosen {
		bootargs = "earlycon=ramcon,0x1f000000 keep_bootcon console=tty0 panic=10 nohlt clk_ignore_unused pd_ignore_unused cma=0 e6.usbsh videocore.debug=1";
	};
};

&i2c0 {
	status = "disabled";
};

/* the l220 address is from the e6 rom, not checked on this phone */
/delete-node/ &l2c;