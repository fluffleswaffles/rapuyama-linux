/* e6-usb.dts + the VideoCore display driver (drivers/soc/rapuyama/videocore.c).
 * the kernel boots the VC itself (firmware in /lib/firmware/vc, see
 * build-vc.sh), sets the panel up and exposes /dev/fb0 with fbcon on it */
/include/ "e6-usb.dts"

/ {
	chosen {
		bootargs = "earlycon=ramcon,0x1f000000 keep_bootcon console=tty0 panic=10 nohlt clk_ignore_unused pd_ignore_unused cma=0 e6.usbsh e6.fbtest";
	};

	/* ViSSI host bus to the BCM2727. clock: power resource 0x18
	 * EHwClkViSSI. RUN = gpio 92 (high = VC runs), HAT (gpio 63) is
	 * polled through the bus status instead */
	videocore@20025800 {
		compatible = "nokia,rapuyama-videocore";
		/* ViSSI bus, gfx dma, the pll, gfx clock divider and shared pad mux */
		reg = <0x20025800 0x100>, <0x20024800 0x300>,
		      <0x20032664 0x4>, <0x20033038 0x4>, <0x200318e0 0x24>;
		clocks = <&cgc 0x18>;
		interrupts = <146>; /* vcdriver binds gfx completion IRQ 0x92 */
		run-gpios = <&gpio 92 0>;
	};
};